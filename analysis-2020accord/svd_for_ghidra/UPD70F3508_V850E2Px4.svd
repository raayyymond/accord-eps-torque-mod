# UPD70F3508 register map
Vendor: Renesas; Series: V850E2/Px4; File version: 1.0
Renesas V850E2/Px4 (uPD70F3508) automotive MCU. SVD generated from R01UH0098EJ0100 hardware manual for Ghidra import.
CPU: other r0p0, little endian, no MPU, FPU, 4 interrupt priority bits
Registers are 8-bit, read-write, reset 0x0 unless marked. A register's access mark holds for its fields unless they carry their own. Offsets are from the block's base; lines under a group give offsets from that group; [hi:lo] are bit positions; {n}, {i} and the like mark numbered series; 'fields as' and 'values as' point back to an identical list; <NAME> marks a mode.

## Memory map
0xFF404000 PORT_CFG size 0xC19 — Port 0 electrical configuration registers (merged: PORT0_CFG, PORT1_CFG, PORT2_CFG, PORT3_CFG, PORT4_CFG, PORT5_CFG, PORT6_CFG, PORT7_CFG, PORT8_CFG)
0xFF410000 DNF size 0x2406 — Digital noise filter control registers (n=0..36, Table 2-58/2-59/2-61)
0xFF414000 FCLA0 size 0x1 — Edge detection filter group 0 - NMI (Table 2-65)
0xFF414100 FCLA1 size 0x1D — Edge detection filter group 1 - INTP0..7 (Table 2-65)
0xFF414200 FCLA2 size 0x9 — Edge detection filter group 2 - INTP8..10 (Table 2-65)
0xFF420014 RESET size 0x19 — Reset Controller (protection command, status, reset flags, software reset)
0xFF420030 BRGA0 blocks up to offset 0xBDFCD1 — Baud-Rate Generator A0 for CLKOUT pin clock output
0xFF420034 DNFSCTL size 0x2 — Digital noise filter sampling clock control register (Table 2-62)
0xFF42003C BIST_CTL size 0x1 — Self-Diagnostic BIST Control Register (µPD70F3505A only, at Reset Controller address space)
0xFF432000 ECC_CFLASH size 0x10 — Code Flash ECC Error Detection and Address Registers
0xFF436000 DFLASH size 0x1 — Data Flash Access Wait Setting Register (Section 3.6)
0xFF438000 FLASH_FLMD size 0x9 — FLMD Pin Control Registers (FLMD0 pull-up/pull-down and write protection)
0xFF440000 JTAG_PORT0 size 0x432 — JTAG port 0 control registers (Table 2-8)
0xFF450020 LVICNT size 0x1 — LVI Control Register (address cluster 0xFF450020) — part of POF/LVI functional block
0xFF454000 PBUS size 0x11 — Peripheral I/O Bus PSELG Error Detection and Control
0xFF460000 ECC_CAN0 size 0x104 — CAN0 RAM ECC Control Registers (E6A0CTL, E6A1CTL)
0xFF460800 ECC_CAN1 size 0x104 — CAN1 RAM ECC Control Registers (E6A2CTL, E6A3CTL)
0xFF464000 ECC_FLEXRAY size 0x604 — FlexRay RAM ECC Control Registers (E7A0CTL to E7A6CTL; not on µPD70F3505A) (merged: ECC_FLEXRAY, ECC_FLX)
0xFF468000 ECC_RAM size 0x10 — On-chip RAM ECC Error Detection and Address Registers
0xFF470000 FLASH_OPT blocks up to offset 0x2C — Flash Option-Byte and Product Identification Registers
0xFF480000 FCN0 blocks up to offset 0x1102C — CAN Controller (FCN) instance 0
0xFF4A0000 FCN1 size 0x12000 — CAN Controller (FCN) instance 1
0xFF580000 FLX0 size 0x718 — FlexRay controller 0 (E-Ray)
0xFF5C0000 UARTH0 blocks up to offset 0xA3EA3C — Synchronous/Asynchronous Serial Interface H, instance 0
0xFF5D0000 UARTH1 blocks up to offset 0xA2EB3C — Synchronous/Asynchronous Serial Interface H, instance 1
0xFF5E0000 UARTH2 blocks up to offset 0xA1EC3C — Synchronous/Asynchronous Serial Interface H, instance 2
0xFF6C0000 CSIH0_B0 blocks up to offset 0x1064 — Queue-Equipped Three-Line Serial Interface H 0, Bank 0 (control/config registers at base0)
0xFF6D0000 CSIH1_B0 blocks up to offset 0x1054 — Queue-Equipped Three-Line Serial Interface H 1, Bank 0 (control/config registers at base0; CS0-CS3 only)
0xFF700010 CSIG0_B0 blocks up to offset 0x1004 — Clocked Serial Interface G 0 - base0 region (CTL1, CTL2, CFG0)
0xFF710010 CSIG1_B0 blocks up to offset 0x1004 — Clocked Serial Interface G 1 - base0 region (CTL1, CTL2, CFG0)
0xFF720010 CSIG2_B0 blocks up to offset 0x1004 — Clocked Serial Interface G 2 - base0 region (CTL1, CTL2, CFG0)
0xFF800020 OSTM0 blocks up to offset 0x7FBFF9 — OS Timer 0 (OSTM0)
0xFF801020 OSTM1 blocks up to offset 0x7FB0F9 — OS Timer 1 (OSTM1)
0xFF802000 CLMA0 size 0x15 — Clock Monitor A, instance 0 — monitors main oscillator
0xFF803000 CLMA1 size 0x15 — Clock Monitor A, instance 1 — monitors internal system clock
0xFF804000 CLMA2 size 0x15 — Clock Monitor A, instance 2 — monitors internal oscillator
0xFF806000 WDTA0 size 0xD — Window Watchdog Timer A, instance 0
0xFF808000 TAUA0 blocks up to offset 0x7F45CA — Timer Array Unit A 0
0xFF809000 TAUA1 blocks up to offset 0x7F39CA — Timer Array Unit A 1
0xFF811080 TAUJ0_CFG size 0x25 — Timer Array Unit J 0 - Configuration Registers (base0)
0xFF812080 TAUJ1_CFG size 0x25 — Timer Array Unit J 1 - Configuration Registers (base0)
0xFF815020 TAPA0_CTL size 0x5 — Timer Option Module 0 Control Registers (base0 region)
0xFF816020 TAPA1_CTL size 0x5 — Timer Option Module 1 Control Registers (base0 region)
0xFF817020 TAPA2_CTL size 0x2 — Timer Option Module 2 Control Registers (base0 region; no CTL1)
0xFF818020 TAPA3_CTL size 0x2 — Timer Option Module 3 Control Registers (base0 region; no CTL1)
0xFF819040 ENCA0_CTL size 0x5 — Encoder Timer 0 — control register bank (base0+0x40 = 0xFF819040)
0xFF81A040 ENCA1_CTL size 0x5 — Encoder Timer 1 — control register bank (base0+0x40 = 0xFF81A040)
0xFF81C080 PIC size 0x69 — Peripheral Interconnection Controller 0 — main register cluster (merged: PIC0, PIC0_TAPA)
0xFF81D100 ADCA0_CTRL size 0x24 — A/D Converter A0 - Control/Config register block (ADCAn_base0=0xFF81D000, offsets 0x100-0x123)
0xFF81DB00 PIC0_CTRL size 0x1 — Peripheral Interconnection Controller 0 — isolated control registers (PIC0EN enable + PIC0SST simultaneous start trigger)
0xFF82E200 TSG20 blocks up to offset 0x7CEAC6 — TSG2 Three-phase PWM Timer 0 (Section 15)
0xFF82F200 TSG21 blocks up to offset 0x7CDEC6 — TSG2 Three-phase PWM Timer 1 (Section 15)
0xFF832000 TPBA0 blocks up to offset 0x7CD131 — Timer Pulse Buffer Array 0 — 16-bit PWM timer with duty setting buffer (instance 0)
0xFF833000 TPBA1 blocks up to offset 0x7CC531 — Timer Pulse Buffer Array 1 — 16-bit PWM timer with duty setting buffer (instance 1)
0xFF836020 DCRA0_CTL size 0x1 — Data CRC Function A, instance 0 — CTL register (base1 = 0xFF836000)
0xFF837020 DCRA1_CTL size 0x1 — Data CRC Function A, instance 1 — CTL register (base1 = 0xFF837000)
0xFF83A000 INTC_CFG size 0xD — Interrupt Controller FE/EI Switch and Flag Registers
0xFF83B000 BIST size 0x10 — Self-Diagnostic BIST Sequence and Protection Registers
0xFF83C000 SGAM size 0x38 — Safety Guardian Master register area
0xFF83D000 SGAC size 0x38 — Safety Guardian Checker register area
0xFF83E000 SGA_COMMON size 0x30 — Safety Guardian common register area (accessed simultaneously by both master and checker)
0xFF83F000 OSTM_CKSEL size 0x6 — OSTM Input Clock Select Function Registers (shared, applies to both OSTM instances)
0xFF83F020 BIST_AUX size 0x20 — SGA Error Pulse Control and Backup RAM Registers (merged: BIST_AUX, SGA_EPCTL)
0xFFFF5024 TSC size 0x5C — Timing Supervision Counter registers — count, compare, and reload values for channels 0-5 (Table 9-31)
0xFFFF5110 PPU size 0x1C — CPU Core Protection Peripheral Protection Unit violation registers (Table 9-30)
0xFFFF6000 INTC size 0x460 — Interrupt Controller
0xFFFF6490 CPUREG size 0x2 — CPU Processor Element Identifier Register (Section 3.6)
0xFFFF64B0 SYSERR size 0x4 — System Error Notification Function Registers (Section 3.7)
0xFFFF7300 DMAC size 0x18B — DMA Controller — 8-channel DMAC register block
0xFFFF7B00 DTFR size 0x46 — DMA Trigger Factor Registers and DMA Request Control
0xFFFF7C00 DTS size 0x24 — Data Transfer Service Control Registers (CPU-accessible Group A)
0xFFFF7D00 DTSFSL size 0x108 — DTS Factor Selector — DTSENn transfer enable registers (n=0..111) and DTSHENm hold enable registers (m=0..3)
0xFFFF8000 PORT_DATA size 0x920 — Port 0 data and mode control registers (merged: PORT0_DATA, PORT1_DATA, PORT2_DATA, PORT3_DATA, PORT4_DATA, PORT5_DATA, PORT6_DATA, PORT7_DATA, PORT8_DATA)
0xFFFFC200 TAUJ0 size 0x6D — Timer Array Unit J 0 - Channel Registers (base1)
0xFFFFC300 TAUJ1 size 0x6D — Timer Array Unit J 1 - Channel Registers (base1)
0xFFFFD400 TAPA0 size 0x19 — Timer Option Module 0 Status and Trigger Registers (base1 region)
0xFFFFD500 TAPA1 size 0x19 — Timer Option Module 1 Status and Trigger Registers (base1 region)
0xFFFFD600 TAPA2 size 0x19 — Timer Option Module 2 Status and Trigger Registers (base1 region)
0xFFFFD700 TAPA3 size 0x19 — Timer Option Module 3 Status and Trigger Registers (base1 region)
0xFFFFD800 ENCA0 size 0x21 — Encoder Timer 0 — main register bank (base1 = 0xFFFFD800)
0xFFFFD900 ENCA1 size 0x21 — Encoder Timer 1 — main register bank (base1 = 0xFFFFD900)
0xFFFFDB04 PIC0_SST size 0x1 — Peripheral Interconnection Controller 0 — Simultaneous Start Trigger register
0xFFFFDC00 ADCA0_DATA size 0xDE — A/D Converter A0 - Data/Status/Trigger register block (ADCAn_base1=0xFFFFDC00, offsets 0x00-0xDD)
0xFFFFE000 CSIH0_B1 size 0x9C — Queue-Equipped Three-Line Serial Interface H 0, Bank 1 (memory/Tx/Rx/status registers at base1)
0xFFFFE100 CSIH1_B1 size 0x9C — Queue-Equipped Three-Line Serial Interface H 1, Bank 1 (memory/Tx/Rx/status registers at base1)
0xFFFFE400 CSIG0_B1 size 0x8E — Clocked Serial Interface G 0 - base1 region (CTL0, STR0, STCR0, BCTL0, TX0W, TX0H, RX0)
0xFFFFE500 CSIG1_B1 size 0x8E — Clocked Serial Interface G 1 - base1 region (CTL0, STR0, STCR0, BCTL0, TX0W, TX0H, RX0)
0xFFFFE600 CSIG2_B1 size 0x8E — Clocked Serial Interface G 2 - base1 region (CTL0, STR0, STCR0, BCTL0, TX0W, TX0H, RX0)
0xFFFFFA00 DCRA0 size 0x8 — Data CRC Function A, instance 0 — CIN/COUT registers (base0 = 0xFFFFFA00)
0xFFFFFB00 DCRA1 size 0x8 — Data CRC Function A, instance 1 — CIN/COUT registers (base0 = 0xFFFFFB00)
0xFFFFFC00 POFLVI size 0x11 — Power-On Flag and LVI Status registers (base cluster 0xFFFFFC00)
0xFFFFFE00 UARTH_IC0 size 0x8 — LIN Communications Slave Operation Baud-Rate Detection Registers (IC0REG0/IC0REG1)
